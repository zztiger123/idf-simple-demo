## example/coex/ble_wifi_coex_c3/main/sdkconfig.defaults
```kconfig
# Override some defaults so BT stack is enabled
# in this example

#
# BT config
#
CONFIG_BT_ENABLED=y
CONFIG_BTDM_CTRL_MODE_BLE_ONLY=y
CONFIG_BTDM_CTRL_MODE_BR_EDR_ONLY=n
CONFIG_BTDM_CTRL_MODE_BTDM=n
#
# ESP32-specific config
#
CONFIG_ESP32_ENABLE_STACK_BT=y
# CONFIG_ESP32_ENABLE_STACK_NONE is not set
CONFIG_MEMMAP_BT=y


#
# Partition Table
#
# CONFIG_PARTITION_TABLE_SINGLE_APP is not set
# CONFIG_PARTITION_TABLE_SINGLE_APP_LARGE is not set
# CONFIG_PARTITION_TABLE_TWO_OTA is not set
CONFIG_PARTITION_TABLE_CUSTOM=y
CONFIG_PARTITION_TABLE_CUSTOM_FILENAME="partitions.csv"
CONFIG_PARTITION_TABLE_FILENAME="partitions.csv"
CONFIG_PARTITION_TABLE_OFFSET=0x8000
CONFIG_PARTITION_TABLE_MD5=y
```

## example/coex/ble_wifi_coex_c3/sdkconfig.defaults
```kconfig
# Override some defaults so BT stack is enabled
# by default in this example
CONFIG_BT_ENABLED=y
CONFIG_BTDM_CTRL_MODE_BLE_ONLY=y
CONFIG_BTDM_CTRL_MODE_BR_EDR_ONLY=n
CONFIG_BTDM_CTRL_MODE_BTDM=n



CONFIG_FREERTOS_GENERATE_RUN_TIME_STATS=y


CONFIG_ESPTOOLPY_FLASHSIZE_4MB=y

CONFIG_PARTITION_TABLE_CUSTOM=y
CONFIG_PARTITION_TABLE_CUSTOM_FILENAME="partitions.csv"
CONFIG_PARTITION_TABLE_FILENAME="partitions.csv"
CONFIG_PARTITION_TABLE_OFFSET=0x8000
CONFIG_PARTITION_TABLE_MD5=y
```

## example/protocols/http_request_static_ip/components/wifi_station/Kconfig.projbuild
```kconfig
menu "Example Connection Configuration"

    config EXAMPLE_CONNECT_WIFI
        bool "connect using WiFi interface"
        default y
        help
            Protocol examples can use Wi-Fi and/or Ethernet to connect to the network.
            Choose this option to connect with WiFi

    if EXAMPLE_CONNECT_WIFI
        config ESP_WIFI_SSID
            string "WiFi SSID"
            default "myssid"
            help
                SSID (network name) for the example to connect to.

        config ESP_WIFI_PASSWORD
            string "WiFi Password"
            default "mypassword"
            help
                WiFi password (WPA or WPA2) for the example to use.

        config ESP_MAXIMUM_RETRY
            int "Maximum retry"
            default 5
            help
                Set the Maximum retry to avoid station reconnecting to the AP unlimited when the AP is really inexistent.
        endif

    config ENABLE_STATIC_IP
        bool "enable using static ip"
        default n
        help
            Using ststic ip to replace the dynamic ip

    if ENABLE_STATIC_IP
        config STATIC_IP_ADDR
            string "STATIC IP ADDR"
            default "192.168.1.102"
            help
                static ip addr for the example.

        config STATIC_IP_GATEWAY_ADDR
            string "STATIC IP GATEWAY ADDR"
            default "192.168.1.1"
            help
                static ip gateway addr for the example.
        
        config STATIC_IP_NETMASK_ADDR
            string "STATIC IP NETMASK ADDR"
            default "255.255.255.0"
            help
                static ip gateway addr for the example.
        
        config DNS_ADDR
            string "DNS ADDR"
            default "8.8.8.8"
            help
                dns addr for the example.
    endif

endmenu
```

## example/wifi/sta_ap/main/Kconfig.projbuild
```kconfig
menu "Example Configuration"

    config ESP_WIFI_STA_SSID
        string "WiFi STA_SSID"
        default "mystassid"
        help
            SSID (network name) for the example to connect to.

    config ESP_WIFI_STA_PASSWORD
        string "WiFi_STA_Password"
        default "mypassword"
        help
            WiFi password (WPA or WPA2) for the example to use.

    config ESP_WIFI_AP_SSID
        string "WiFi AP_SSID"
        default "myapssid"
        help
            SSID (network name) for the example to connect to.

    config ESP_WIFI_AP_PASSWORD
        string "WiFi_AP_Password"
        default "mypassword"
        help
            WiFi password (WPA or WPA2) for the example to use.



endmenu
```

## station/main/Kconfig.projbuild
```kconfig
menu "Example STA Configuration"

    config ESP_WIFI_STA_SSID
        string "WiFi SSID"
        default "myssid"
        help
            SSID (network name) for the example to connect to.

    config ESP_WIFI_STA_PASSWORD
        string "WiFi Password"
        default "mypassword"
        help
            WiFi password (WPA or WPA2) for the example to use.

    config ESP_STA_MAXIMUM_RETRY
        int "Maximum retry"
        default 5
        help
            Set the Maximum retry to avoid station reconnecting to the AP unlimited when the AP is really inexistent.
endmenu


menu "Example AP Configuration"

    config ESP_WIFI_AP_SSID
        string "WiFi SSID"
        default "myssid"
        help
            SSID (network name) for the example to connect to.

    config ESP_WIFI_AP_PASSWORD
        string "WiFi Password"
        default "mypassword"
        help
            WiFi password (WPA or WPA2) for the example to use.
    config ESP_WIFI_AP_CHANNEL
        int "WiFi Channel"
        range 1 13
        default 1
        help
            WiFi channel (network channel) for the example to use.

    config ESP_MAX_STA_CONN
        int "Maximal STA connections"
        default 4
        help
            Max number of the STA connects to AP.
endmenu
```
